## firmware/jc8012p4/installer/main/Kconfig.projbuild
```kconfig
menu "PokeChanger C6 installer"
config POKECHANGER_C6_INSTALLER_WRITE
    bool "Include C6 application and enable explicit serial INSTALL command"
    default n
    help
        Default build only queries the C6. This option embeds the radio app;
        writing still requires INSTALL followed by its exact SHA256 on UART0.
endmenu
```

## firmware/jc8012p4/installer/sdkconfig.defaults
```kconfig
CONFIG_IDF_TARGET="esp32p4"
CONFIG_ESPTOOLPY_FLASHSIZE_16MB=y
CONFIG_ESP32P4_SELECTS_REV_LESS_V3=y
CONFIG_ESP32P4_REV_MIN_1=y
CONFIG_SPIRAM=y
CONFIG_SPIRAM_SPEED_200M=y
CONFIG_SPIRAM_USE_MALLOC=y
CONFIG_ESP_CONSOLE_UART_DEFAULT=y
CONFIG_FREERTOS_HZ=1000
CONFIG_ESP_WIFI_REMOTE_ENABLED=y
CONFIG_ESP_HOSTED=y
CONFIG_ESP_HOSTED_HOST_TRANSPORT_BUS_SDIO=y
CONFIG_ESP_HOSTED_HOST_RESET_GPIO=54
CONFIG_ESP_HOSTED_HOST_SDIO_PIN_CLK=18
CONFIG_ESP_HOSTED_HOST_SDIO_PIN_CMD=19
CONFIG_ESP_HOSTED_HOST_SDIO_PIN_D0=14
CONFIG_ESP_HOSTED_HOST_SDIO_PIN_D1=15
CONFIG_ESP_HOSTED_HOST_SDIO_PIN_D2=16
CONFIG_ESP_HOSTED_HOST_SDIO_PIN_D3=17
CONFIG_ESP_HOSTED_HOST_SDIO_CLK_KHZ=20000
CONFIG_PARTITION_TABLE_CUSTOM=y
CONFIG_PARTITION_TABLE_CUSTOM_FILENAME="partitions.csv"
CONFIG_ESP_MAIN_TASK_STACK_SIZE=8192
```
